## configs/usbarmory-mark-two_defconfig
```kconfig
CONFIG_ARM=y
CONFIG_ARCH_MX6=y
CONFIG_TEXT_BASE=0x87800000
CONFIG_TARGET_USBARMORY_MARK_TWO=y
CONFIG_MX6ULL=y

CONFIG_SYS_DDR_512MB=y
# CONFIG_SYS_DDR_1GB is not set

# Boot device
# CONFIG_SYS_BOOT_DEV_MICROSD is not set
CONFIG_SYS_BOOT_DEV_EMMC=y

# Environment
CONFIG_ENV_OFFSET=0x100000
CONFIG_ENV_SIZE=0x2000
CONFIG_USE_HOSTNAME=y
CONFIG_HOSTNAME="usbarmory"
CONFIG_SYS_CBSIZE=512

# Boot mode
CONFIG_SYS_BOOT_MODE_CUSTOM=y
# CONFIG_SYS_BOOT_MODE_NORMAL=y
# CONFIG_SYS_BOOT_MODE_UMS=y
# CONFIG_SYS_BOOT_MODE_UMS is not set
# CONFIG_SYS_BOOT_MODE_TFTP is not set
# CONFIG_SYS_BOOT_MODE_VERIFIED_OPEN is not set
# CONFIG_SYS_BOOT_MODE_VERIFIED_LOCKED is not set

CONFIG_NR_DRAM_BANKS=1
CONFIG_USE_BOOTCOMMAND=y
CONFIG_DOS_PARTITION=y
CONFIG_FSL_USDHC=y
CONFIG_SYS_MEMTEST_START=0x80000000
CONFIG_SYS_MALLOC_LEN=0xA00000

# Commands
CONFIG_CMD_DHCP=y
CONFIG_CMD_EXT2=y
CONFIG_CMD_FUSE=y
CONFIG_CMD_I2C=y
CONFIG_CMD_MEMTEST=y
CONFIG_CMD_MMC=y
CONFIG_CMD_PING=y
CONFIG_CMD_USB=y

# Device model support
CONFIG_DM=y
CONFIG_DM_ETH=y
CONFIG_DM_MMC=y
CONFIG_DM_USB=y
CONFIG_DM_I2C=y
CONFIG_DM_GPIO=y
CONFIG_DM_SERIAL=y
CONFIG_MXC_UART=y
CONFIG_SYS_I2C_MXC=y
CONFIG_SYS_I2C_MXC_I2C1=y
CONFIG_SYS_I2C_SPEED=100000
CONFIG_BLK=y
CONFIG_OF_LIBFDT=y
CONFIG_OF_CONTROL=y
CONFIG_OF_SEPARATE=y
CONFIG_DEFAULT_DEVICE_TREE="imx6ulz-usbarmory"

# Secure/Verified boot
CONFIG_IMX_HAB=y
CONFIG_FIT=y
CONFIG_FIT_SIGNATURE=y
CONFIG_RSA=y

# USB gadgets
CONFIG_USB=y
CONFIG_CI_UDC=y
CONFIG_USB_GADGET=y
CONFIG_USB_GADGET_MANUFACTURER="FSL"
CONFIG_USB_GADGET_VENDOR_NUM=0x0525
CONFIG_USB_GADGET_PRODUCT_NUM=0xa4a5
CONFIG_USB_FUNCTION_ACM=y

# USB TTY
CONFIG_USB_DEVICE=y
CONFIG_USB_TTY=y
CONFIG_SYS_CONSOLE_IS_IN_ENV=y

# UMS gadget
CONFIG_USB_GADGET_DOWNLOAD=y
CONFIG_CMD_USB_MASS_STORAGE=y

# Ethernet gadget
CONFIG_USB_ETHER=y
CONFIG_USB_ETH_CDC=y

# TEE support
CONFIG_TEE=y
CONFIG_OPTEE=y
CONFIG_BOOTM_OPTEE=y
CONFIG_LEGACY_IMAGE_FORMAT=y
```
